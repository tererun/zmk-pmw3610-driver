## dts/bindings/behaviors/zmk,behavior-pmw3610-scroll-direction.yaml
```yaml
# Copyright (c) 2026 The ZMK Contributors
# SPDX-License-Identifier: MIT

description: PMW3610 Scroll Direction Behavior

compatible: "zmk,behavior-pmw3610-scroll-direction"

include: two_param.yaml
```
